// SPDX-License-Identifier: MIT
// STM32MP157C-DK2: TX FIFOs of the USB OTG controller for the composite NCM + CDC-ACM gadget.
// The release's layout gives 256 words to the first IN endpoint and 16 to the others: the bulk
// endpoints of the second function find no FIFO ("No suitable fifo found") and the host refuses
// the NCM interface. Same layout as on the STM32MP135F-DK.
/dts-v1/;
/plugin/;

/ {
    compatible = "st,stm32mp157c-dk2";

    fragment@0 {
        target-path = "/soc/bus@5c007000/usb-otg@49000000";
        __overlay__ {
            g-tx-fifo-size = <128 128 64 16 16 16 16 16>;
        };
    };
};
